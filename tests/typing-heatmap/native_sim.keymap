#include "../test.dtsi"

/ {
    combos {
        compatible = "zmk,combos";
        combo_ab {
            timeout-ms = <30>;
            key-positions = <0 1>;
            bindings = <&kp B>;
        };
    };
};

&kscan {
    events = <
        ZMK_MOCK_PRESS(0,0,10)
        ZMK_MOCK_PRESS(0,1,10)
        ZMK_MOCK_RELEASE(0,0,10)
        ZMK_MOCK_RELEASE(0,1,10)
        ZMK_MOCK_PRESS(0,0,50)
        ZMK_MOCK_RELEASE(0,0,10)
        ZMK_MOCK_PRESS(1,0,10)
        ZMK_MOCK_RELEASE(1,0,10)
        ZMK_MOCK_PRESS(1,1,10)
        ZMK_MOCK_RELEASE(1,1,200)
        ZMK_MOCK_RELEASE(1,1,10)
    >;
};
